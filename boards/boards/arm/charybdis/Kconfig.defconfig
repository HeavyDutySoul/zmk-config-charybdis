## boards/boards/arm/charybdis/Kconfig.defconfig
```kconfig
# Copyright (c) 2021 The ZMK Contributors
# SPDX-License-Identifier: MIT

if BOARD_CHARYBDIS_LEFT

config ZMK_KEYBOARD_NAME
	default "Charybdis"

config ZMK_SPLIT_ROLE_CENTRAL
  default y

endif # BOARD_CHARYBDIS_LEFT

if BOARD_CHARYBDIS_LEFT || BOARD_CHARYBDIS_RIGHT

config BOARD
	default "charybdis"

config ZMK_SPLIT
	default y

config BT_CTLR
	default BT

config ZMK_BLE
	default y

config ZMK_USB
	default n

config ZMK_BATTERY_VOLTAGE_DIVIDER
	default y

if USB

config USB_NRFX
	default y

config USB_DEVICE_STACK
	default y

endif # USB

endif # BOARD_CHARYSBDIS_LEFT || BOARD_CHARYBDIS_RIGHT
```

## config/boards/arm/charybdis/charybdis_right_defconfig
```kconfig
# SPDX-License-Identifier: MIT

CONFIG_SOC_SERIES_NRF52X=y
CONFIG_SOC_NRF52840_QIAA=y
CONFIG_BOARD_CHARYBDIS_RIGHT=y
CONFIG_ZMK_SLEEP=y
CONFIG_ZMK_IDLE_SLEEP_TIMEOUT=120000

#CONFIG_ZMK_USB_LOGGING=y
#CONFIG_LOG_MODE_IMMEDIATE=n
#CONFIG_LOG_PROCESS_THREAD_STARTUP_DELAY_MS=2000
#CONFIG_ZMK_LOG_LEVEL_DBG=y
#CONFIG_KSCAN_LOG_LEVEL_INF=y
#CONFIG_SPI_LOG_LEVEL_INF=y
#CONFIG_BATTERY_LOG_LEVEL_DBG=y
#CONFIG_PMW3360_LOG_LEVEL_INF=y

CONFIG_BT_CTLR_TX_PWR_PLUS_8=y

CONFIG_BT_LL_SW_LLCP_LEGACY=y

CONFIG_ARM_MPU=y

CONFIG_GPIO=y

CONFIG_USE_DT_CODE_PARTITION=y
CONFIG_BUILD_OUTPUT_UF2=y

CONFIG_MPU_ALLOW_FLASH_WRITE=y
CONFIG_NVS=y
CONFIG_SETTINGS_NVS=y
CONFIG_FLASH=y
CONFIG_FLASH_PAGE_LAYOUT=y
CONFIG_FLASH_MAP=y
CONFIG_CLOCK_CONTROL_NRF_K32SRC_RC=y

##### Point Devices ####
CONFIG_SPI=y
# CONFIG_ZMK_PD_WORK_QUEUE_DEDICATED=n
CONFIG_ZMK_PD_DEDICATED_WORK_QUEUE_PRIORITY=2
CONFIG_ZMK_TRACKBALL_POLL_DURATION=8

CONFIG_ZMK_MOUSE=y
CONFIG_ZMK_MOUSE_TICK_DURATION=10
CONFIG_ZMK_MOUSE_WORK_QUEUE_DEDICATED=y
CONFIG_ZMK_MOUSE_DEDICATED_THREAD_PRIORITY=1

CONFIG_MOUSE_LAYER_ACTIVE_MS=900
CONFIG_MOUSE_LAYER_INDEX=4

CONFIG_PMW3360=y
CONFIG_PMW3360_CPI=4200
CONFIG_PMW3360_CPI_DIVIDOR=4
#CONFIG_PMW3360_ORIENTATION_90=y
#CONFIG_PMW3360_REST1_SAMPLE_TIME_MS=100
#CONFIG_PMW3360_REST2_SAMPLE_TIME_MS=200
#CONFIG_PMW3360_REST3_SAMPLE_TIME_MS=250
CONFIG_PMW3360_RUN_DOWNSHIFT_TIME_MS=500
CONFIG_PMW3360_REST1_DOWNSHIFT_TIME_MS=5000
CONFIG_PMW3360_REST2_DOWNSHIFT_TIME_MS=30000
```
