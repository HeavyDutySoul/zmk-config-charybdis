## boards/arm/charybdis-bt/board.yml
```yaml
boards:
  - name: charybdis_left
    vendor: bastardkb
    socs:
      - name: nrf52840
  - name: charybdis_right
    vendor: bastardkb
    socs:
      - name: nrf52840
  - name: charybdis_left_sr
    vendor: bastardkb
    socs:
      - name: nrf52840
```

## boards/arm/charybdis/Kconfig.board
```kconfig
# Jorian840 board configuration

# Copyright (c) 2021 The ZMK Contributors
# SPDX-License-Identifier: MIT

config BOARD_CHARYBDIS_LEFT
  select SOC_NRF52840_QIAA

config BOARD_CHARYBDIS_RIGHT
  select SOC_NRF52840_QIAA
```

## boards/arm/charybdis/Kconfig.defconfig
```kconfig
# Copyright (c) 2021 The ZMK Contributors
# SPDX-License-Identifier: MIT

if BOARD_CHARYBDIS_LEFT || BOARD_CHARYBDIS_RIGHT

config BOARD
  default "charybdis"

config ZMK_SPLIT
  default y

config ZMK_BLE
  default y

config ZMK_USB
  default n

endif # BOARD_CHARYSBDIS_LEFT || BOARD_CHARYBDIS_RIGHT
```

## boards/arm/charybdis/charybdis_left_defconfig
```kconfig
CONFIG_ZMK_SLEEP=y
CONFIG_ZMK_IDLE_SLEEP_TIMEOUT=1200000

CONFIG_ZMK_BATTERY_REPORTING=y
CONFIG_ZMK_BATTERY_REPORT_INTERVAL=600

CONFIG_ZMK_BLE_EXPERIMENTAL_CONN=y

CONFIG_ZMK_SPLIT_BLE=y

CONFIG_PM_DEVICE=y

CONFIG_ARM_MPU=y

CONFIG_GPIO=y

CONFIG_USE_DT_CODE_PARTITION=y
CONFIG_BUILD_OUTPUT_UF2=y

CONFIG_MPU_ALLOW_FLASH_WRITE=y
CONFIG_NVS=y
CONFIG_SETTINGS_NVS=y
CONFIG_FLASH=y
CONFIG_FLASH_PAGE_LAYOUT=y
CONFIG_FLASH_MAP=y

CONFIG_CLOCK_CONTROL_NRF=y
CONFIG_CLOCK_CONTROL_NRF_K32SRC_RC=n
CONFIG_CLOCK_CONTROL_NRF_K32SRC_XTAL=y
CONFIG_CLOCK_CONTROL_NRF_K32SRC_20PPM=y

CONFIG_INPUT=y
CONFIG_ZMK_POINTING=y

CONFIG_ZMK_EXT_POWER=y

CONFIG_BT_GATT_ENFORCE_SUBSCRIPTION=n

CONFIG_ZMK_BEHAVIORS_QUEUE_SIZE=512
```

## boards/arm/charybdis/charybdis_right_defconfig
```kconfig
CONFIG_ZMK_SLEEP=y
CONFIG_ZMK_IDLE_SLEEP_TIMEOUT=1200000

CONFIG_ZMK_BATTERY_REPORTING=y
CONFIG_ZMK_BATTERY_REPORT_INTERVAL=600

CONFIG_ZMK_SPLIT_BLE=y

CONFIG_PM_DEVICE=y

CONFIG_ARM_MPU=y

CONFIG_GPIO=y

CONFIG_USE_DT_CODE_PARTITION=y
CONFIG_BUILD_OUTPUT_UF2=y

CONFIG_MPU_ALLOW_FLASH_WRITE=y
CONFIG_NVS=y
CONFIG_SETTINGS_NVS=y
CONFIG_FLASH=y
CONFIG_FLASH_PAGE_LAYOUT=y
CONFIG_FLASH_MAP=y

CONFIG_CLOCK_CONTROL_NRF=y
CONFIG_CLOCK_CONTROL_NRF_K32SRC_RC=n
CONFIG_CLOCK_CONTROL_NRF_K32SRC_XTAL=y
CONFIG_CLOCK_CONTROL_NRF_K32SRC_20PPM=y

CONFIG_INPUT=y
CONFIG_ZMK_POINTING=y

CONFIG_ZMK_EXT_POWER=y

CONFIG_BT_GATT_ENFORCE_SUBSCRIPTION=n

CONFIG_ZMK_BEHAVIORS_QUEUE_SIZE=512

CONFIG_SPI=y
CONFIG_SPI_NRFX_RAM_BUFFER_SIZE=32
#CONFIG_SPI_LOG_LEVEL_DBG=y

CONFIG_PMW3610=y

CONFIG_PMW3610_SMART_ALGORITHM=y

CONFIG_PMW3610_REPORT_INTERVAL_MIN=20
CONFIG_PMW3610_IGNORE_AFTER_REST=y
#CONFIG_PMW3610_INIT_POWER_UP_EXTRA_DELAY_MS=1000

CONFIG_PMW3610_REST1_SAMPLE_TIME_MS=100
CONFIG_PMW3610_REST2_SAMPLE_TIME_MS=200
CONFIG_PMW3610_REST3_SAMPLE_TIME_MS=300
CONFIG_PMW3610_RUN_DOWNSHIFT_TIME_MS=2000
CONFIG_PMW3610_REST1_DOWNSHIFT_TIME_MS=3000
CONFIG_PMW3610_REST2_DOWNSHIFT_TIME_MS=30000
```

## config/west.yml
```yaml
manifest:
  remotes:
    - name: zmkfirmware
      url-base: https://github.com/zampierilucas
    - name: efogdev
      url-base: https://github.com/efogdev
    - name: heavydutysoul
      url-base: https://github.com/HeavyDutySoul
  projects:
    - name: zmk
      remote: heavydutysoul
      revision: feat/minimal-battery-reporting
      import: app/west.yml
    - name: zmk-pmw3610-driver
      remote: efogdev
      revision: zephyr-4.1
  self:
    path: config
```
