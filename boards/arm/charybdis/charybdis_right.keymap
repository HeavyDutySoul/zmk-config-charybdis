/*
 * Copyright (c) 2021 The ZMK Contributors
 *
 * SPDX-License-Identifier: MIT
 */

#include "charybdis.keymap"

/ {
  behaviors {
    dpi_cycle: sensor_dpi_cycle {
      compatible = "zmk,behavior-sensor-attr-cycle";
      #binding-cells = <1>;
      values = < 100 300 600 900 1200 >;
      attr = <0>;
      sensor_device = <&trackball>;
      display-name = "DPI cycle";
      persistant;
    };
  };
};
