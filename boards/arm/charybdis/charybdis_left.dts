/*
 * Copyright (c) 2021 The ZMK Contributors
 *
 * SPDX-License-Identifier: MIT
 */

/dts-v1/;
#include <nordic/nrf52840_qiaa.dtsi>
#include "charybdis.dtsi"
#include "split_input_common.dtsi"

&kscan0 {
    compatible = "zmk,kscan-gpio-matrix";

    col-gpios
        = <&gpio0 3  (GPIO_ACTIVE_HIGH | GPIO_PULL_DOWN)>
        , <&gpio0 2  (GPIO_ACTIVE_HIGH | GPIO_PULL_DOWN)>
        , <&gpio0 29 (GPIO_ACTIVE_HIGH | GPIO_PULL_DOWN)>
        , <&gpio1 4  (GPIO_ACTIVE_HIGH | GPIO_PULL_DOWN)>
        , <&gpio1 6  (GPIO_ACTIVE_HIGH | GPIO_PULL_DOWN)>
        , <&gpio0 9  (GPIO_ACTIVE_HIGH | GPIO_PULL_DOWN)>
        ;
    row-gpios
        = <&gpio0 28 (GPIO_ACTIVE_HIGH )>
        , <&gpio1 15  (GPIO_ACTIVE_HIGH )>
        , <&gpio1 10 (GPIO_ACTIVE_HIGH )>
        , <&gpio1 13  (GPIO_ACTIVE_HIGH )>
        , <&gpio0 10  (GPIO_ACTIVE_HIGH )>
    ;
    wakeup-source;
};

&trackball_listener {
  status = "okay";
};
