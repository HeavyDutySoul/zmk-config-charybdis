/*
 * Copyright (c) 2020 The ZMK Contributors
 *
 * SPDX-License-Identifier: MIT
 */

/dts-v1/;
#include <nordic/nrf52840_qiaa.dtsi>
#include <dt-bindings/zmk/matrix_transform.h>

/ {
    chosen {
        zmk,kscan = &settings_reset_kscan;
    };

    settings_reset_kscan: settings_reset_kscan {
        compatible = "zmk,kscan-mock";
        columns = <1>;
        rows = <0>;

        events = <>;
    };

};
